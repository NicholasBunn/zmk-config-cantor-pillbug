/ {
    chosen {
        zmk,kscan = &default_kscan;
    };

    default_kscan: kscan {
        compatible = "zmk,kscan-gpio-direct";
        wakeup-source;
        label = "default_kscan";
        input-gpios
            = <&blackpill 19 (GPIO_ACTIVE_HIGH | GPIO_PULL_DOWN)>
            , <&blackpill 21 (GPIO_ACTIVE_HIGH | GPIO_PULL_DOWN)>
            , <&blackpill 29 (GPIO_ACTIVE_HIGH | GPIO_PULL_DOWN)>
            , <&blackpill 28 (GPIO_ACTIVE_HIGH | GPIO_PULL_DOWN)>
            , <&blackpill 27 (GPIO_ACTIVE_HIGH | GPIO_PULL_DOWN)>
            , <&blackpill 26 (GPIO_ACTIVE_HIGH | GPIO_PULL_DOWN)>
            , <&blackpill 46 (GPIO_ACTIVE_HIGH | GPIO_PULL_DOWN)>
            , <&blackpill 45 (GPIO_ACTIVE_HIGH | GPIO_PULL_DOWN)>
            , <&blackpill 41 (GPIO_ACTIVE_HIGH | GPIO_PULL_DOWN)>
            , <&blackpill 40 (GPIO_ACTIVE_HIGH | GPIO_PULL_DOWN)>
            , <&blackpill 39 (GPIO_ACTIVE_HIGH | GPIO_PULL_DOWN)>
            , <&blackpill 38 (GPIO_ACTIVE_HIGH | GPIO_PULL_DOWN)>
            , <&blackpill 13 (GPIO_ACTIVE_HIGH | GPIO_PULL_DOWN)>
            , <&blackpill 14 (GPIO_ACTIVE_HIGH | GPIO_PULL_DOWN)>
            , <&blackpill 15 (GPIO_ACTIVE_HIGH | GPIO_PULL_DOWN)>
            , <&blackpill 16 (GPIO_ACTIVE_HIGH | GPIO_PULL_DOWN)>
            , <&blackpill 17 (GPIO_ACTIVE_HIGH | GPIO_PULL_DOWN)>
            , <&blackpill 18 (GPIO_ACTIVE_HIGH | GPIO_PULL_DOWN)>
            , <&blackpill 12 (GPIO_ACTIVE_HIGH | GPIO_PULL_DOWN)>
            , <&blackpill 11 (GPIO_ACTIVE_HIGH | GPIO_PULL_DOWN)>
            , <&blackpill 10 (GPIO_ACTIVE_HIGH | GPIO_PULL_DOWN)>
            ;
    };
};
